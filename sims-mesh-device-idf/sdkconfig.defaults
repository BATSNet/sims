## sims-mesh-device-idf/sdkconfig.defaults
```kconfig
# ESP-IDF Configuration Defaults for SIMS Mesh Device
# Heltec WiFi LoRa 32 V3 (ESP32-S3 + SX1262)

# ESP32-S3 Configuration
CONFIG_IDF_TARGET="esp32s3"
CONFIG_IDF_TARGET_ESP32S3=y

# No PSRAM (Heltec V3 has none)
CONFIG_ESP32S3_SPIRAM_SUPPORT=n
CONFIG_SPIRAM=n

# Flash Configuration (8MB flash)
CONFIG_ESPTOOLPY_FLASHSIZE_8MB=y
CONFIG_ESPTOOLPY_FLASHSIZE="8MB"
CONFIG_ESPTOOLPY_FLASHMODE_QIO=y
CONFIG_ESPTOOLPY_FLASHFREQ_80M=y

# Partition Table
CONFIG_PARTITION_TABLE_CUSTOM=y
CONFIG_PARTITION_TABLE_CUSTOM_FILENAME="partitions.csv"
CONFIG_PARTITION_TABLE_FILENAME="partitions.csv"

# FreeRTOS Configuration
CONFIG_FREERTOS_HZ=1000
CONFIG_FREERTOS_UNICORE=n
CONFIG_ESP_TASK_WDT_TIMEOUT_S=10

# Bluetooth - NimBLE
CONFIG_BT_ENABLED=y
CONFIG_BT_NIMBLE_ENABLED=y
CONFIG_BT_NIMBLE_MAX_CONNECTIONS=3
CONFIG_BT_NIMBLE_ROLE_CENTRAL=n
CONFIG_BT_NIMBLE_ROLE_OBSERVER=n
CONFIG_BT_NIMBLE_ROLE_PERIPHERAL=y
CONFIG_BT_NIMBLE_ROLE_BROADCASTER=y
CONFIG_BT_NIMBLE_NVS_PERSIST=y
CONFIG_BT_NIMBLE_50_FEATURE_SUPPORT=n

# SPI Master (for LoRa SX1262)
CONFIG_SPI_MASTER_ISR_IN_IRAM=y

# UART (for GPS)
CONFIG_UART_ISR_IN_IRAM=y

# I2C (for OLED)
CONFIG_I2C_ISR_IN_IRAM=y

# Serial Console
CONFIG_ESP_CONSOLE_UART_DEFAULT=y
CONFIG_ESP_CONSOLE_UART_BAUDRATE=115200

# Logging
CONFIG_LOG_DEFAULT_LEVEL_INFO=y
CONFIG_LOG_MAXIMUM_LEVEL_VERBOSE=y

# NVS
CONFIG_NVS_ENCRYPTION=n

# SPIFFS Configuration
CONFIG_SPIFFS_MAX_PARTITIONS=3

# C++ Exceptions (RadioLib uses them)
CONFIG_COMPILER_CXX_EXCEPTIONS=y

# Serial port for flashing
CONFIG_ESPTOOLPY_PORT="COM7"
```

## sims-smart-espidf/main/Kconfig.projbuild
```kconfig
menu "SIMS-SMART Configuration"

    config SIMS_WIFI_SSID
        string "WiFi SSID"
        default "iPhone"
        help
            Default WiFi network name. Can also be overridden at runtime via NVS.

    config SIMS_WIFI_PASSWORD
        string "WiFi Password"
        default "letsrock"
        help
            Default WiFi password. Can also be overridden at runtime via NVS.

    config SIMS_BACKEND_URL
        string "Backend API URL"
        default "http://91.99.179.35:8000/api/lora/incident"
        help
            URL for the SIMS backend incident upload endpoint.

endmenu
```

## sims-smart-espidf/sdkconfig.defaults
```kconfig
# ESP-IDF Configuration Defaults for SIMS-SMART
# Seeed Studio XIAO ESP32S3 Sense

# ESP32S3 Configuration
CONFIG_IDF_TARGET="esp32s3"
CONFIG_IDF_TARGET_ESP32S3=y

# PSRAM Configuration (8MB PSRAM on XIAO ESP32S3)
CONFIG_ESP32S3_SPIRAM_SUPPORT=y
CONFIG_SPIRAM_MODE_OCT=y
CONFIG_SPIRAM_SPEED_80M=y
CONFIG_SPIRAM=y
CONFIG_SPIRAM_BOOT_INIT=y
CONFIG_SPIRAM_USE_MALLOC=y
CONFIG_SPIRAM_MALLOC_ALWAYSINTERNAL=16384
CONFIG_SPIRAM_TRY_ALLOCATE_WIFI_LWIP=y

# Flash Configuration (8MB flash)
CONFIG_ESPTOOLPY_FLASHSIZE_8MB=y
CONFIG_ESPTOOLPY_FLASHSIZE="8MB"
CONFIG_ESPTOOLPY_FLASHMODE_QIO=y
CONFIG_ESPTOOLPY_FLASHFREQ_80M=y

# Partition Table
CONFIG_PARTITION_TABLE_CUSTOM=y
CONFIG_PARTITION_TABLE_CUSTOM_FILENAME="partitions.csv"
CONFIG_PARTITION_TABLE_FILENAME="partitions.csv"

# FreeRTOS Configuration
CONFIG_FREERTOS_HZ=1000
CONFIG_FREERTOS_UNICORE=n
CONFIG_ESP_TASK_WDT_TIMEOUT_S=10

# WiFi Configuration
CONFIG_ESP32_WIFI_STATIC_RX_BUFFER_NUM=10
CONFIG_ESP32_WIFI_DYNAMIC_RX_BUFFER_NUM=32
CONFIG_ESP32_WIFI_DYNAMIC_TX_BUFFER_NUM=32
CONFIG_ESP32_WIFI_AMPDU_TX_ENABLED=y
CONFIG_ESP32_WIFI_AMPDU_RX_ENABLED=y

# Bluetooth (disable to save memory)
CONFIG_BT_ENABLED=n

# Serial Console
CONFIG_ESP_CONSOLE_UART_DEFAULT=y
CONFIG_ESP_CONSOLE_UART_BAUDRATE=115200

# Logging
CONFIG_LOG_DEFAULT_LEVEL_INFO=y
CONFIG_LOG_MAXIMUM_LEVEL_VERBOSE=y

# Camera Configuration
CONFIG_CAMERA_CORE0=y

# HTTP Client
CONFIG_ESP_HTTP_CLIENT_ENABLE_HTTPS=y

# SPIFFS Configuration
CONFIG_SPIFFS_MAX_PARTITIONS=3

# USB Serial JTAG (for XIAO ESP32S3)
CONFIG_ESP_CONSOLE_USB_SERIAL_JTAG=y

# Power Management
CONFIG_PM_ENABLE=y

# ESP32-SR Voice Recognition
CONFIG_USE_AFE_SR=y
CONFIG_USE_MULTINET=y
CONFIG_USE_WAKENET=y
CONFIG_MODEL_IN_FLASH=y

# WakeNet9 "Hi ESP" wake word model
CONFIG_SR_WN_WN9_HIESP=y

# MultiNet6 English command recognition model
CONFIG_SR_MN_EN_MULTINET6_QUANT=y

# cJSON (used by HTTP client)
CONFIG_CJSON_NESTING_LIMIT=10

# Serial port for flashing
CONFIG_ESPTOOLPY_PORT="COM8"
```
